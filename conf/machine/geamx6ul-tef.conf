## conf/machine/geamx6ul-tef.conf
```bitbake
#@TYPE: Machine
#@NAME: geam6 ultralite
#@SOC: i.MX6UL
#@DESCRIPTION: Machine configuration for geam6ul

require conf/machine/include/tune-cortexa7.inc
include conf/machine/include/iCore.inc

UBINIZE_ARGS = "-m 2048 -p 128KiB -s 2048"
MKUBIFS_ARGS = "-m 2048 -e 126976 -c 1944"
UBI_VOLNAME = "rootfs"

SOC_FAMILY = "mx6ul"

KERNEL_DEVICETREE = "geamx6ul-tef.dtb"

UBOOT_CONFIG[sd] = "geamx6ul_sd_defconfig,sdcard"
UBOOT_CONFIG[nand] = "geamx6ul_nand_defconfig"

# IMAGE_FSTYPES = "ubifs"
IMAGE_FSTYPES = "ubifs sdcard tar.bz2"

SDCARD_GENERATION_COMMAND = "generate_imx_sdcard"

SERIAL_CONSOLE = "115200 ttymxc0"
```
